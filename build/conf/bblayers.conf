## build/conf/bblayers.conf
```bitbake
# POKY_BBLAYERS_CONF_VERSION is increased each time build/conf/bblayers.conf
# changes incompatibly
POKY_BBLAYERS_CONF_VERSION = "2"

BBPATH = "${TOPDIR}"
BBFILES ?= ""

BBLAYERS ?= " \
  ${TOPDIR}/../layers/poky/meta \
  ${TOPDIR}/../layers/poky/meta-poky \
  ${TOPDIR}/../layers/meta-sunxi \
  ${TOPDIR}/../layers/meta-openembedded/meta-oe \
  ${TOPDIR}/../layers/meta-openembedded/meta-multimedia \
  ${TOPDIR}/../layers/meta-openembedded/meta-networking \
  ${TOPDIR}/../layers/meta-openembedded/meta-python \
  ${TOPDIR}/../layers/meta-qt5 \
  ${TOPDIR}/../layers/meta-middleby-bsp \
  ${TOPDIR}/../layers/meta-middleby-distro \
  ${TOPDIR}/../layers/meta-fresco \
  ${TOPDIR}/../layers/meta-rauc \
  "
```

## layers/meta-middleby-bsp/conf/layer.conf
```bitbake
# We have a conf and classes directory, add to BBPATH
BBPATH .= ":${LAYERDIR}"

# We have recipes-* directories, add to BBFILES
BBFILES += "${LAYERDIR}/recipes-*/*/*.bb \
            ${LAYERDIR}/recipes-*/*/*.bbappend"

BBFILE_COLLECTIONS += "meta-middleby-bsp"
BBFILE_PATTERN_meta-middleby-bsp = "^${LAYERDIR}/"
BBFILE_PRIORITY_meta-middleby-bsp = "6"

LAYERDEPENDS_meta-middleby-bsp = "core"
LAYERSERIES_COMPAT_meta-middleby-bsp = "kirkstone"
```

## layers/meta-middleby-bsp/conf/machine/mlui-lcd5.conf
```bitbake
#@TYPE: Machine
#@NAME: Middleby MLUI Board, 5" display
#@DESCRIPTION: Machine configuration for the Middleby MLUI Board, based on Allwinner A64 CPU with 5" display

require conf/machine/include/sun50i.inc

PREFFERED_VERSION_u-boot = "v2018.09%"

MACHINE_EXTRA_RRECOMMENDS += " linux-firmware-rtl8723"

KERNEL_DEVICETREE = "allwinner/sun50i-a64-mlui.dtb"
KERNEL_DEFCONFIG = "mlui_defconfig"
UBOOT_MACHINE = "a64-mlui_defconfig"
PREFERRED_VERSION_linux-mainline = "5.10.2"

UBOOT_BINARY = "u-boot.img"

WKS_FILE ?= "core-image-synesso-sdcard.wks.in"
IMAGE_CLASSES += "image_types_wic"
IMAGE_FSTYPES = "wic ext4"
IMAGE_BOOT_FILES_label-boot = "boot.scr"
IMAGE_BOOT_FILES_label-kernel = "Image sun50i-a64-mlui.dtb;allwinner/sun50i-a64-mlui.dtb"
```

## layers/meta-middleby-bsp/conf/machine/mlui-lcd7-usmp-t070.conf
```bitbake
#@TYPE: Machine
#@NAME: Middleby MLUI Board, 7" US Micro T070 display
#@DESCRIPTION: Machine configuration for the Middleby MLUI Board, based on Allwinner A64 CPU with US Micro T070 display

require conf/machine/include/sun50i.inc

PREFFERED_VERSION_u-boot = "v2018.09%"

MACHINE_EXTRA_RRECOMMENDS += " linux-firmware-rtl8723"

KERNEL_DEVICETREE = "allwinner/sun50i-a64-mlui.dtb"
KERNEL_DEFCONFIG = "mlui_defconfig"
UBOOT_MACHINE = "a64-mlui_defconfig"
PREFERRED_VERSION_linux-mainline = "5.10.2"

UBOOT_BINARY = "u-boot.bin"

WKS_FILE ?= "core-image-viking-sdcard.wks.in"
IMAGE_CLASSES += "image_types_wic"
IMAGE_FSTYPES = "wic ext4"
IMAGE_BOOT_FILES_label-boot = "boot.scr"
IMAGE_BOOT_FILES_label-kernelA = "Image sun50i-a64-mlui.dtb;allwinner/sun50i-a64-mlui.dtb"
IMAGE_BOOT_FILES_label-kernelB = "Image sun50i-a64-mlui.dtb;allwinner/sun50i-a64-mlui.dtb"
```

## layers/meta-middleby-distro/conf/distro/mlui.conf
```bitbake
DISTRO = "mlui"
DISTRO_NAME = "Middleby Distribution for MLUI Board"
DISTRO_VERSION = "0.0.1"
DISTRO_CODENAME = "mlui"
SDK_VENDOR = "-middlebysdk"
SDK_VERSION := "${@'${DISTRO_VERSION}'.replace('snapshot-${DATE}','snapshot')}"

MAINTAINER = "Rudolf J Streif <rudolf.streif@ibeeto.com>"

TARGET_VENDOR = "-middleby"

LOCALCONF_VERSION = "1"

DISTRO_VERSION[vardepsexclude] = "DATE"
SDK_VERSION[vardepsexclude] = "DATE"

# Set hostname
hostname_pn-base-files = "mlui"

# Override these for Middleby distros
MLUI_DEFAULT_DISTRO_FEATURES = "largefile ptest multiarch opengl pulseaudio wayland bluetooth"
MLUI_DEFAULT_EXTRA_RDEPENDS = "packagegroup-core-boot"
MLUI_DEFAULT_EXTRA_RRECOMMENDS = "kernel-module-af-packet"

DISTRO_FEATURES ?= "${DISTRO_FEATURES_DEFAULT} ${DISTRO_FEATURES_LIBC} ${MLUI_DEFAULT_DISTRO_FEATURES}"
DISTRO_EXTRA_RDEPENDS += " ${MLUI_DEFAULT_EXTRA_RDEPENDS}"
DISTRO_EXTRA_RRECOMMENDS += " ${MLUI_DEFAULT_EXTRA_RRECOMMENDS}"

DISTRO_FEATURES:remove = "x11"

# Configure systemd
DISTRO_FEATURES:append = " pam systemd"
VIRTUAL-RUNTIME_init_manager = "systemd"
DISTRO_FEATURES_BACKFILL_CONSIDERED = "sysvinit"
VIRTUAL-RUNTIME_initscripts = ""

#PREFERRED_PROVIDER_virtual/libgles2 = "vc-graphics-hardfp"
#PREFERRED_PROVIDER_virtual/egl = "vc-graphics-hardfp"
PREFERRED_PROVIDER_virtual/nativesdk-libgl ?= "nativesdk-mesa-gl"

SDK_NAME = "${DISTRO}-${TCLIBC}-${SDK_ARCH}-${IMAGE_BASENAME}-${TUNE_PKGARCH}"
SDKPATH = "/opt/${DISTRO}/${SDK_VERSION}"

# Additional settings for Qemu machines
SBUX_QEMUDEPS = "${@bb.utils.contains("INCOMPATIBLE_LICENSE", "GPL-3.0", "", "packagegroup-core-device-devel",d)}"
DISTRO_EXTRA_RDEPENDS:append_qemuarm = " ${SBUX_QEMUDEPS}"
DISTRO_EXTRA_RDEPENDS:append_qemuarm64 = " ${SBUX_QEMUDEPS}"
DISTRO_EXTRA_RDEPENDS:append_qemumips = " ${SBUX_QEMUDEPS}"
DISTRO_EXTRA_RDEPENDS:append_qemuppc = " ${SBUX_QEMUDEPS}"
DISTRO_EXTRA_RDEPENDS:append_qemux86 = " ${SBUX_QEMUDEPS}"
DISTRO_EXTRA_RDEPENDS:append_qemux86-64 = " ${SBUX_QEMUDEPS}"
QEMU_TARGETS ?= "arm aarch64 i386 mips mipsel mips64 mips64el nios2 ppc x86_64"

TCLIBCAPPEND = ""

# Change for setting your own pre-mirrors
PREMIRRORS ??= "\
bzr://.*/.*   http://downloads.yoctoproject.org/mirror/sources/ \n \
cvs://.*/.*   http://downloads.yoctoproject.org/mirror/sources/ \n \
git://.*/.*   http://downloads.yoctoproject.org/mirror/sources/ \n \
gitsm://.*/.* http://downloads.yoctoproject.org/mirror/sources/ \n \
hg://.*/.*    http://downloads.yoctoproject.org/mirror/sources/ \n \
osc://.*/.*   http://downloads.yoctoproject.org/mirror/sources/ \n \
p4://.*/.*    http://downloads.yoctoproject.org/mirror/sources/ \n \
svn://.*/.*   http://downloads.yoctoproject.org/mirror/sources/ \n"

MIRRORS =+ "\
ftp://.*/.*      http://downloads.yoctoproject.org/mirror/sources/ \n \
http://.*/.*     http://downloads.yoctoproject.org/mirror/sources/ \n \
https://.*/.*    http://downloads.yoctoproject.org/mirror/sources/ \n"

# The CONNECTIVITY_CHECK_URI's are used to test whether we can succesfully
# fetch from the network (and warn you if not). To disable the test set
# the variable to be empty.
# Git example url: git://git.yoctoproject.org/yocto-firewall-test;protocol=git;rev=master
CONNECTIVITY_CHECK_URIS ?= "https://www.example.com/"

SANITY_TESTED_DISTROS ?= " \
            poky-2.4 \n \
            poky-2.5 \n \
            ubuntu-15.04 \n \
            ubuntu-16.04 \n \
            ubuntu-18.04 \n \
            fedora-28 \n \
            centos-7 \n \
            debian-8 \n \
            debian-9 \n \
            opensuse-42.3 \n \
            "
#
# OELAYOUT_ABI allows us to notify users when the format of TMPDIR changes in
# an incompatible way. Such changes should usually be detailed in the commit
# that breaks the format and have been previously discussed on the mailing list
# with general agreement from the core team.
#
OELAYOUT_ABI = "14"

# add poky sanity bbclass
INHERIT += "poky-sanity"

# QA check settings - a little stricter than the OE-Core defaults
WARN_TO_ERROR_QA = "already-stripped compile-host-path install-host-path \
                    installed-vs-shipped ldflags pn-overrides rpaths staticdev \
                    useless-rpaths"
WARN_QA:remove = "${WARN_TO_ERROR_QA}"
ERROR_QA:append = " ${WARN_TO_ERROR_QA}"

require conf/distro/include/poky-world-exclude.inc
require conf/distro/include/no-static-libs.inc
require conf/distro/include/yocto-uninative.inc
INHERIT += "uninative"
```

## layers/meta-middleby-distro/conf/layer.conf
```bitbake
# We have a conf and classes directory, add to BBPATH
BBPATH .= ":${LAYERDIR}"

# We have recipes-* directories, add to BBFILES
BBFILES += "${LAYERDIR}/recipes-*/*/*.bb \
            ${LAYERDIR}/recipes-*/*/*.bbappend"

BBFILE_COLLECTIONS += "meta-middleby-distro"
BBFILE_PATTERN_meta-middleby-distro = "^${LAYERDIR}/"
BBFILE_PRIORITY_meta-middleby-distro = "6"

LAYERDEPENDS_meta-middleby-distro = "core"
LAYERSERIES_COMPAT_meta-middleby-distro = "kirkstone"
```
